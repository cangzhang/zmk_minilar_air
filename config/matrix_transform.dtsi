/ {
    matrix_transform {
        compatible = "zmk,matrix-transform";
        rows = <8>;
        cols = <16>;
        map = <
            0   1   2   3   4   5   6   7   8   9   10  11  -1  -1  -1  -1
            12  13  14  15  -1  16  17  18  19  20  21  -1  22  -1  -1  -1
            23  24  25  26  -1  27  28  29  30  31  -1  32  -1  33  -1  -1
            34  35  -1  -1  -1  36  -1  -1  -1  -1  37  -1  -1  -1  -1  -1
            38  39  40  41  -1  42  43  44  -1  45  -1  46  -1  -1  -1  -1
            -1  -1  -1  -1  -1  47  -1  -1  -1  48  -1  49  50  51  52  53
            54  55  -1  -1  -1  -1  56  57  -1  -1  58  -1  -1  -1  -1  -1
            59  60  61  62  -1  -1  -1  -1  -1  -1  -1  -1  -1  -1  -1  -1
        >;
    };
};